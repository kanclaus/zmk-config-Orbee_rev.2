## config/boards/shields/Orbee/Kconfig.shield
```kconfig
config SHIELD_ORBEE_R
    def_bool $(shields_list_contains,Orbee_R)

config SHIELD_ORBEE_L
    def_bool $(shields_list_contains,Orbee_L)

# --- バッテリー電圧範囲 ---
config ZMK_BATTERY_VOLTAGE_MIN
    int "Minimum battery voltage"
    default 3300
    help
      Minimum voltage (mV) for the battery. Used for reporting battery percentage.

config ZMK_BATTERY_VOLTAGE_MAX
    int "Maximum battery voltage"
    default 4200
    help
      Maximum voltage (mV) for the battery. Used for reporting battery percentage.
```
